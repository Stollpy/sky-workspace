## firmware/components/sky_core/Kconfig
```kconfig
menu "Sky Core"

    config SKY_CORE_EVENT_MAX_SUBSCRIBERS
        int "Maximum event subscribers"
        default 32
        range 8 128
        help
            Maximum number of concurrent event subscriptions across
            all components. Each subscription costs ~16 bytes of RAM.

    config SKY_CORE_EVENT_QUEUE_SIZE
        int "Event queue size (async mode)"
        default 16
        range 4 64
        help
            Size of the FreeRTOS queue for asynchronous event dispatch.

    config SKY_CORE_REGISTRY_MAX_SERVICES
        int "Maximum registered services"
        default 16
        range 4 32
        help
            Maximum number of services that can be registered in the
            service registry simultaneously.

    config SKY_CORE_CRASH_MAX_ENTRIES
        int "Maximum crash handler entries"
        default 16
        range 4 32
        help
            Maximum number of components that can register crash
            safety handlers.

    config SKY_CORE_CRASH_DEFAULT_WDT_TIMEOUT_S
        int "Default watchdog timeout (seconds)"
        default 10
        range 5 60
        help
            Default task watchdog timeout for components that do not
            specify their own timeout.

endmenu
```

## firmware/components/sky_http_server/Kconfig
```kconfig
menu "Sky HTTP Server"

    config SKY_HTTP_SERVER_ENABLED
        bool "Enable HTTP Server"
        default y
        help
            Active le serveur HTTP Sky.
            Désactiver pour économiser de la flash/RAM
            si le firmware n'a pas besoin de servir du HTTP.

    config SKY_HTTP_SERVER_PORT
        int "HTTP port"
        default 80
        range 1 65535
        depends on SKY_HTTP_SERVER_ENABLED

    config SKY_HTTP_SERVER_MAX_URI_HANDLERS
        int "Maximum URI handlers"
        default 16
        range 4 64
        depends on SKY_HTTP_SERVER_ENABLED

    config SKY_HTTP_SERVER_STACK_SIZE
        int "Server task stack size (bytes)"
        default 4096
        range 2048 16384
        depends on SKY_HTTP_SERVER_ENABLED

endmenu
```

## firmware/components/sky_matter/Kconfig
```kconfig
menu "Sky Matter"

    config SKY_MATTER_ENABLED
        bool "Enable Matter protocol support"
        default n
        help
            Requires the esp-matter SDK.
            Leave disabled until the SDK is integrated into the build.

    config SKY_MATTER_DEVICE_NAME
        string "Default device name"
        default "Sky Device"

    config SKY_MATTER_VENDOR_ID
        hex "Matter Vendor ID"
        default 0xFFF1
        help
            CSA Vendor ID. Use 0xFFF1 for development.
            Production requires a registered Vendor ID from the CSA.

    config SKY_MATTER_PRODUCT_ID
        hex "Matter Product ID"
        default 0x0001

    config SKY_MATTER_SETUP_PASSCODE
        int "Default setup passcode"
        default 20202021

    config SKY_MATTER_DISCRIMINATOR
        hex "Default BLE discriminator (12-bit)"
        default 0xF00

endmenu
```

## firmware/components/sky_ota/Kconfig
```kconfig
menu "Sky OTA"

    config SKY_OTA_UPDATE_URL
        string "Default OTA update URL"
        default "https://update.sky.stollpy.com/firmware"
        help
            HTTPS endpoint serving firmware binaries.
            Resolved via local DNS in the home network.

    config SKY_OTA_SELF_TEST_TIMEOUT_MS
        int "Self-test timeout after OTA (ms)"
        default 30000
        range 5000 120000

    config SKY_OTA_CHECK_INTERVAL_MS
        int "Periodic check interval (ms, 0 = manual only)"
        default 0
        range 0 86400000

    config SKY_OTA_AUTO_UPDATE
        bool "Automatically apply available updates"
        default n

    config SKY_OTA_SKIP_SERVER_CERT
        bool "Skip TLS server certificate verification (dev only)"
        default y
        help
            Disable for production. Enable during development when
            using self-signed certificates on the local OTA server.

endmenu
```

## firmware/components/sky_power/Kconfig
```kconfig
menu "Sky Power"

    config SKY_POWER_BATTERY_THRESHOLD_LOW
        int "Battery low threshold (%)"
        default 20
        range 5 50

    config SKY_POWER_BATTERY_THRESHOLD_CRITICAL
        int "Battery critical threshold (%)"
        default 5
        range 1 20

    config SKY_POWER_SAMPLE_INTERVAL_MS
        int "Battery sample interval (ms)"
        default 60000
        range 1000 600000
        help
            How often to read the battery ADC. Default 60s.

    config SKY_POWER_SAMPLE_AVERAGE
        int "Number of ADC samples to average"
        default 16
        range 1 64

    config SKY_POWER_ADC_PIN
        int "Battery ADC pin (GPIO)"
        default 34
        range 32 39
        help
            Must be an ADC1 pin (32-39). GPIO 34-39 are input-only.

    config SKY_POWER_IDLE_TIMEOUT_MS
        int "Idle timeout before sleep (ms)"
        default 30000
        range 0 600000
        help
            Time after last wakelock release before entering idle mode.
            0 = disabled.

    config SKY_POWER_IDLE_MODE
        int "Idle power mode (0=active, 1=modem, 2=light, 3=deep)"
        default 1
        range 0 3

endmenu
```

## firmware/components/sky_stepper/Kconfig
```kconfig
menu "Sky Stepper"

    config SKY_STEPPER_MAX_MOTORS
        int "Maximum number of stepper motors"
        default 4
        range 1 8
        help
            Maximum number of stepper motors that can be registered
            simultaneously on a single ESP32.

    config SKY_STEPPER_MAX_HOOKS
        int "Maximum hooks per motor"
        default 8
        range 4 16

    config SKY_STEPPER_DEFAULT_TASK_PRIORITY
        int "Default FreeRTOS task priority for motor tasks"
        default 5
        range 1 24

    config SKY_STEPPER_DEFAULT_STACK_SIZE
        int "Default stack size for motor tasks (bytes)"
        default 4096
        range 2048 8192

    config SKY_STEPPER_CMD_QUEUE_SIZE
        int "Command queue depth per motor"
        default 8
        range 4 16

    config SKY_STEPPER_POSITION_EVENT_INTERVAL
        int "Steps between position events"
        default 100
        range 10 1000
        help
            Publish a position event every N steps during movement.

    config SKY_STEPPER_CALIBRATION_TIMEOUT_S
        int "Calibration safety timeout (seconds)"
        default 120
        range 30 600
        help
            Auto-stop calibration if the client does not respond
            within this timeout.

    config SKY_STEPPER_MAX_PATTERNS
        int "Maximum patterns per motor"
        default 8
        range 1 16

endmenu
```

## firmware/components/sky_wifi/Kconfig
```kconfig
menu "Sky Wi-Fi"

    config SKY_WIFI_DEFAULT_SSID
        string "Default Wi-Fi SSID (development only)"
        default ""
        help
            Leave empty to use NVS-stored credentials or provisioning.

    config SKY_WIFI_DEFAULT_PASSWORD
        string "Default Wi-Fi password (development only)"
        default ""

    config SKY_WIFI_HOSTNAME
        string "Default mDNS hostname"
        default "sky-device"

    config SKY_WIFI_MAX_RETRY
        int "Maximum reconnection attempts (0 = infinite)"
        default 0
        range 0 255

    config SKY_WIFI_RETRY_INTERVAL_MS
        int "Base reconnection interval (ms)"
        default 5000
        range 1000 60000
        help
            Interval doubles on each failure (exponential backoff),
            capped at 5x this value.

endmenu
```

## firmware/sdkconfig.defaults
```kconfig
# Sky Framework — sdkconfig defaults

# Partition table
CONFIG_PARTITION_TABLE_CUSTOM=y
CONFIG_PARTITION_TABLE_CUSTOM_FILENAME="partitions.csv"

# FreeRTOS
CONFIG_FREERTOS_HZ=1000

# Watchdog
CONFIG_ESP_TASK_WDT=y
CONFIG_ESP_TASK_WDT_TIMEOUT_S=10

# Wi-Fi
CONFIG_ESP_WIFI_SOFTAP_SUPPORT=y

# BLE (commissioning Matter)
CONFIG_BT_ENABLED=y
CONFIG_BT_NIMBLE_ENABLED=y

# Log level
CONFIG_LOG_DEFAULT_LEVEL_INFO=y

# Compiler optimizations (Matter firmware is large)
CONFIG_COMPILER_OPTIMIZATION_SIZE=y

# OTA rollback support
CONFIG_BOOTLOADER_APP_ROLLBACK_ENABLE=y
```

## firmware/sdkconfig.defaults.example
```kconfig
# Sky Framework — sdkconfig defaults
#
# Copy this file to sdkconfig.defaults and fill in your Wi-Fi credentials:
#   cp sdkconfig.defaults.example sdkconfig.defaults

# Partition table
CONFIG_PARTITION_TABLE_CUSTOM=y
CONFIG_PARTITION_TABLE_CUSTOM_FILENAME="partitions.csv"

# FreeRTOS
CONFIG_FREERTOS_HZ=1000

# Watchdog
CONFIG_ESP_TASK_WDT=y
CONFIG_ESP_TASK_WDT_TIMEOUT_S=10

# Wi-Fi
CONFIG_ESP_WIFI_SOFTAP_SUPPORT=y

# BLE (commissioning Matter)
CONFIG_BT_ENABLED=y
CONFIG_BT_NIMBLE_ENABLED=y

# Log level
CONFIG_LOG_DEFAULT_LEVEL_INFO=y

# Compiler optimizations (Matter firmware is large)
CONFIG_COMPILER_OPTIMIZATION_SIZE=y

# OTA rollback support
CONFIG_BOOTLOADER_APP_ROLLBACK_ENABLE=y

# HTTP server — 25 routes need more than the default 16 slots
CONFIG_SKY_HTTP_SERVER_MAX_URI_HANDLERS=32

# Wi-Fi credentials — fill in your own
CONFIG_SKY_WIFI_DEFAULT_SSID=""
CONFIG_SKY_WIFI_DEFAULT_PASSWORD=""
```
